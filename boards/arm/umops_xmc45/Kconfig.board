## boards/arm/umops_xmc45/Kconfig.board
```kconfig
config BOARD_UMPOS_XMC45
	bool "KAI uMoPS XMC45"
	depends on SOC_SERIES_XMC_4XXX
	select SOC_PART_NUMBER_F100X1024
```

## boards/arm/umops_xmc45/Kconfig.defconfig
```kconfig
if BOARD_UMPOS_XMC45

config BOARD
	default "umops_xmc45"

endif # BOARD_UMPOS_XMC45
```

## boards/arm/umops_xmc45/umops_xmc45_defconfig
```kconfig
CONFIG_BOARD_UMPOS_XMC45=y
CONFIG_SOC_SERIES_XMC_4XXX=y
CONFIG_SOC_XMC4500=y
CONFIG_CORTEX_M_SYSTICK=y
CONFIG_ARM_MPU=y

# enable uart driver
CONFIG_SERIAL=y
CONFIG_UART_XMC4XXX=y

# enable console
CONFIG_CONSOLE=y
CONFIG_UART_CONSOLE=y

# enable console
CONFIG_GPIO=y

#CONFIG_FLASH_BASE_ADDRESS=0x08000000
#CONFIG_FLASH_LOAD_OFFSET=0
#CONFIG_FLASH_SIZE=1024

#CONFIG_SRAM_BASE_ADDRESS=0x20000000
#CONFIG_SRAM_SIZE=64
```

## build/Kconfig/Kconfig.modules
```kconfig
menu "CANopenNode (/home/sebin/thesis/zephyrproject/modules/lib/canopennode)"
osource "$(ZEPHYR_CANOPENNODE_KCONFIG)"
config ZEPHYR_CANOPENNODE_MODULE
	bool
	default y
endmenu
menu "hal_gigadevice (/home/sebin/thesis/zephyrproject/modules/hal/gigadevice)"
osource "$(ZEPHYR_HAL_GIGADEVICE_KCONFIG)"
config ZEPHYR_HAL_GIGADEVICE_MODULE
	bool
	default y
endmenu
menu "hal_nordic (/home/sebin/thesis/zephyrproject/modules/hal/nordic)"
osource "$(ZEPHYR_HAL_NORDIC_KCONFIG)"
config ZEPHYR_HAL_NORDIC_MODULE
	bool
	default y
endmenu
menu "hal_nxp (/home/sebin/thesis/zephyrproject/modules/hal/nxp)"
osource "$(ZEPHYR_HAL_NXP_KCONFIG)"
config ZEPHYR_HAL_NXP_MODULE
	bool
	default y
endmenu
menu "hal_rpi_pico (/home/sebin/thesis/zephyrproject/modules/hal/rpi_pico)"
osource "$(ZEPHYR_HAL_RPI_PICO_KCONFIG)"
config ZEPHYR_HAL_RPI_PICO_MODULE
	bool
	default y
endmenu
menu "loramac-node (/home/sebin/thesis/zephyrproject/modules/lib/loramac-node)"
osource "$(ZEPHYR_LORAMAC_NODE_KCONFIG)"
config ZEPHYR_LORAMAC_NODE_MODULE
	bool
	default y
endmenu
menu "lz4 (/home/sebin/thesis/zephyrproject/modules/lib/lz4)"
osource "$(ZEPHYR_LZ4_KCONFIG)"
config ZEPHYR_LZ4_MODULE
	bool
	default y
endmenu
menu "mbedtls (/home/sebin/thesis/zephyrproject/modules/crypto/mbedtls)"
osource "$(ZEPHYR_MBEDTLS_KCONFIG)"
config ZEPHYR_MBEDTLS_MODULE
	bool
	default y
endmenu
menu "nanopb (/home/sebin/thesis/zephyrproject/modules/lib/nanopb)"
osource "$(ZEPHYR_NANOPB_KCONFIG)"
config ZEPHYR_NANOPB_MODULE
	bool
	default y
endmenu
menu "sof (/home/sebin/thesis/zephyrproject/modules/audio/sof)"
osource "/home/sebin/thesis/zephyrproject/modules/audio/sof/zephyr/Kconfig"
config ZEPHYR_SOF_MODULE
	bool
	default y
endmenu
menu "tflite-micro (/home/sebin/thesis/zephyrproject/modules/lib/tflite-micro)"
osource "$(ZEPHYR_TFLITE_MICRO_KCONFIG)"
config ZEPHYR_TFLITE_MICRO_MODULE
	bool
	default y
endmenu
menu "TraceRecorder (/home/sebin/thesis/zephyrproject/modules/debug/TraceRecorder)"
osource "/home/sebin/thesis/zephyrproject/modules/debug/TraceRecorder/kernelports/Zephyr/Kconfig"
config ZEPHYR_TRACERECORDER_MODULE
	bool
	default y
endmenu
menu "trusted-firmware-m (/home/sebin/thesis/zephyrproject/modules/tee/tf-m/trusted-firmware-m)"
osource "$(ZEPHYR_TRUSTED_FIRMWARE_M_KCONFIG)"
config ZEPHYR_TRUSTED_FIRMWARE_M_MODULE
	bool
	default y
endmenu
menu "zscilib (/home/sebin/thesis/zephyrproject/modules/lib/zscilib)"
osource "/home/sebin/thesis/zephyrproject/modules/lib/zscilib/Kconfig.zscilib"
config ZEPHYR_ZSCILIB_MODULE
	bool
	default y
endmenu
menu "umops-drivers (/home/sebin/thesis/dmz/zephyr_xmc_template/drivers)"
osource "/home/sebin/thesis/dmz/zephyr_xmc_template/drivers/zephyr/Kconfig"
config ZEPHYR_UMOPS_DRIVERS_MODULE
	bool
	default y
endmenu
```

## build/Kconfig/Kconfig.shield
```kconfig
osource "/home/sebin/thesis/dmz/zephyr_xmc_template/boards/shields/*/Kconfig.shield"
```

## drivers/zephyr/Kconfig
```kconfig
comment "Device Drivers"

rsource "led/Kconfig"
rsource "mux/Kconfig"
rsource "gpio/Kconfig"
rsource "clock_control/Kconfig"
rsource "counter/Kconfig"
rsource "ethernet/Kconfig"
#rsource "timer/Kconfig"
```

## drivers/zephyr/clock_control/Kconfig
```kconfig
config CLOCK_CONTROL_XMC
	bool "XMC Clock driver"
	default y
	help
	  Enable XMC clock driver.
```

## drivers/zephyr/counter/Kconfig
```kconfig
config CCU4_COUNTER_XMC
	bool "XMC CCU4_0 timer slice driver"
	default y
	help
	  This module implements a kernel device driver for  XMC CCU4_0 timer slice
	  and provides the standard "system clock driver" interfaces.
```

## drivers/zephyr/dts/bindings/infineon,xmc-ccu4-0-counter.yaml
```yaml
description: XMC CCU4 timer node

compatible: "infineon,xmc-ccu4-0-counter"

include: [base.yaml]

properties:
    reg:
      required: true

    label:
      required: true
      
    interrupts:
      required: true
    
    prescale:
      type: int
      required: true
      
```

## drivers/zephyr/dts/bindings/infineon,xmc-ccu4-0-timer.yaml
```yaml
description: XMC CCU4 timer node

compatible: "infineon,xmc-ccu4-0-timer"

include: [base.yaml]

properties:
    reg:
      required: true

    label:
      required: true
      
    interrupts:
      required: true
```

## drivers/zephyr/dts/bindings/infineon,xmc-clock.yaml
```yaml
description: XMC clock node

compatible: "infineon,xmc-clock"

include: [base.yaml]

properties:
    reg:
      required: true

    label:
      required: true
```

## drivers/zephyr/dts/bindings/infineon,xmc-gpio.yaml
```yaml
description: XMC GPIO node

compatible: "infineon,xmc-gpio"

include: [gpio-controller.yaml, base.yaml]

properties:
    reg:
      required: true

    label:
      required: true

    "#gpio-cells":
      const: 2

    port:
      type: int
      required: true
      description: |
        The GPIO port number. GPIO port P1 has:

          port = <1>;

gpio-cells:
  - pin
  - flags
```

## drivers/zephyr/dts/bindings/ktd202x.yaml
```yaml
compatible: "kt,ktd202x"
description: KTD202x LED driver

include: ["i2c-device.yaml", "led-controller.yaml"]

properties:
  ramp-time-rise:
    type: int
    required: no
    default: 4
    description: Set the rise time durations for the LED current ramp transitioning between 0mA and the nominal current. Refer to datasheet for details.

  ramp-time-fall:
    type: int
    required: no
    default: 4
    description: Set the fall time durations for the LED current ramp transitioning between 0mA and the nominal current. Refer to datasheet for details.
 
  ramp-time-scaling:
    type: int
    required: no
    default: 0
    description: These setting allow to scale the rise and fall times. Refer to datasheet for details.
```

## drivers/zephyr/dts/bindings/pca9956b.yaml
```yaml
compatible: "nxp,pca9956b"
description: PCA9956B LED driver

include: ["i2c-device.yaml", "led-controller.yaml"]

properties:
  ramp-factor:
    type: int
    required: no
    default: 0
    description: When value greater than 0, a smooth transission between brightness changes is applied (calls are blocking until transission is done).

  current_scaling:
    type: int
    required: no
    default: 255
    description: Factor is applied to all registers IREF0 to IREF23 on startup.
 
```

## drivers/zephyr/dts/bindings/tmux1208.yaml
```yaml
compatible: "ti,tmux1208"

description: TMUX1208 driver
properties:
  addr-gpios:
    type: array
    required: false
    description: Address-GPIOs in the order ad0, ad1, ad2.
  
  en-gpios:
    type: phandle-array
    required: false
    description: Optional Enable-GPIOs.

  label:
    type: string
    required: false
    description: Human readable string describing the device (used as device_get_binding() argument)
```

## drivers/zephyr/ethernet/Kconfig
```kconfig
config ETHERNET_XMC
	bool "XMC Ethernet driver"
	default y
	help
	  This module implements a kernel device driver for  XMC Ethernet driver.
config PTP_CLOCK_XMC
	bool "XMC Ethernet ptp driver"
	default y
    help
	 This module implements a kernel ptp device driver for XMC Ethernet driver.
```

## drivers/zephyr/gpio/Kconfig
```kconfig
config GPIO_XMC
	bool "GPIO driver"
	default y
	help
	  Enable GPIO.

	  Enable GPIO driver
```

## drivers/zephyr/led/ktd202x/Kconfig
```kconfig
config KTD202x
	bool "KTD202x LED driver"
	depends on I2C
	help
	  Enable LED driver for KTD202x.

	  KTD202x LED driver has 3 or 4 channels (RGBW). Each channel can drive up to
	  24 mA per LED.
```

## drivers/zephyr/led/pca9956b/Kconfig
```kconfig
config PCA9956B
	bool "PCA9956B LED driver"
	depends on I2C
	help
	  Enable LED driver for PCA9956B.

	  PCA9956B LED driver has 24 channels constant current LED-driver. Each channel can drive up to
	  57 mA per channel at 20 V input voltage.
```

## drivers/zephyr/mux/tmux1208/Kconfig
```kconfig
config TMUX1208
	bool "TMUX1208 5V Bidirectional 8:1, 1-Channel Multiplexer"
	depends on GPIO
	help
	  Enable driver for TMUX1208.

	  The TMUX1208 is a general purpose complementary metal-oxide semiconductor (CMOS) multiplexers (MUX). 
	  The TMUX1208 offers 8:1 single-ended channels. Wide operating supply of 1.08 V to 5.5 V allows for use in a broad array of applications 
	  from personal electronics to building automation applications. 
	  The device supports bidirectional analog and digital signals on the source (Sx) and drain (D) pins ranging from GND to VDD.
```

## drivers/zephyr/timer/Kconfig
```kconfig
config CCU4_0_TIMER_XMC
	bool "XMC CCU4_0 timer slice driver"
	default n
	select TICKLESS_CAPABLE
	help
	  This module implements a kernel device driver for  XMC CCU4_0 timer slice
	  and provides the standard "system clock driver" interfaces.
```
